/dts-v1/;
/plugin/;

/ {
    fragment@0 {
        target-path = "/soc";
        __overlay__ {
            /* FPGA Sprite Engine device node */
            fpga_sprite: fpga-sprite@0x3F000000 {
                compatible = "csee4840,fpga-sprite-1.0";
                /* Device physical base address and size */
                reg = <0x3F000000 0x1000>;
                status = "okay";
            };
        };
    };
}; 